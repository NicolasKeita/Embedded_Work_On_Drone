## CMakeLists.txt
```
cmake_minimum_required(VERSION 4.4)

set(CMAKE_EXPERIMENTAL_CXX_IMPORT_STD
    "f35a9ac6-8463-4d38-8eec-5d6008153e7d"
    CACHE STRING "Enable experimental C++ import std support")
project(fc1_stm32_bootstrap LANGUAGES NONE)

set(FIRMWARE_NAME fc1_stm32)
set(FIRMWARE_MAIN "${CMAKE_CURRENT_SOURCE_DIR}/src/main.cpp")
set(FIRMWARE_CORE_FILES
    ${CMAKE_CURRENT_SOURCE_DIR}/src/Fc1Firmware.cppm
    ${CMAKE_CURRENT_SOURCE_DIR}/src/Fc1Firmware-State.cpp
    ${CMAKE_CURRENT_SOURCE_DIR}/src/Fc1Firmware-InterFc.cpp
    ${CMAKE_CURRENT_SOURCE_DIR}/src/Fc1Firmware-Control.cpp
    ${CMAKE_CURRENT_SOURCE_DIR}/src/Fc1Firmware-Respond.cpp
    ${CMAKE_CURRENT_SOURCE_DIR}/src/Fc1Firmware-Run.cpp
    ${CMAKE_CURRENT_SOURCE_DIR}/../../Src/Embedded/Status/StatusLed.cppm
    ${CMAKE_CURRENT_SOURCE_DIR}/../../Src/Embedded/Status/StatusLed.cpp
    ${CMAKE_CURRENT_SOURCE_DIR}/../../Src/Simulation/Aircraft.cppm
    ${CMAKE_CURRENT_SOURCE_DIR}/../../Src/Simulation/PhysicsDispersion.cppm
    ${CMAKE_CURRENT_SOURCE_DIR}/../../Src/Control/FlightController.cppm
    ${CMAKE_CURRENT_SOURCE_DIR}/../../Src/Control/FlightController-Core.cpp
    ${CMAKE_CURRENT_SOURCE_DIR}/../../Src/Control/FlightController-Loops.cpp
    ${CMAKE_CURRENT_SOURCE_DIR}/../../Src/Control/FlightController-Mission.cpp
    ${CMAKE_CURRENT_SOURCE_DIR}/../../Src/Control/FlightController-Takeoff.cpp
    ${CMAKE_CURRENT_SOURCE_DIR}/../../Src/Control/Types/FlightControllerTypes.cppm
    ${CMAKE_CURRENT_SOURCE_DIR}/../../Src/Control/Types/FlightControllerTypes.cpp
    ${CMAKE_CURRENT_SOURCE_DIR}/../../Src/Embedded/Hal/HalTypes.cppm
    ${CMAKE_CURRENT_SOURCE_DIR}/../../Src/Embedded/InterFc/InterFcLink.cppm
    ${CMAKE_CURRENT_SOURCE_DIR}/../../Src/Embedded/InterFc/InterFcLink-Codec.cpp
    ${CMAKE_CURRENT_SOURCE_DIR}/../../Src/Embedded/InterFc/InterFcLink-Crc.cpp
    ${CMAKE_CURRENT_SOURCE_DIR}/../../Src/Embedded/InterFc/InterFcLink-Parser.cpp
    ${CMAKE_CURRENT_SOURCE_DIR}/../../Src/Embedded/InterFc/ZephyrUartInterFcTransport.cppm
    ${CMAKE_CURRENT_SOURCE_DIR}/../../Src/Embedded/InterFc/ZephyrUartInterFcTransport.cpp
    ${CMAKE_CURRENT_SOURCE_DIR}/../../Src/Embedded/Transport/HilProtocol.cppm
    ${CMAKE_CURRENT_SOURCE_DIR}/../../Src/Embedded/Transport/Parser/HilProtocolParser.cppm
    ${CMAKE_CURRENT_SOURCE_DIR}/../../Src/Embedded/Transport/Parser/HilProtocolParser-Crc.cpp
    ${CMAKE_CURRENT_SOURCE_DIR}/../../Src/Embedded/Transport/Parser/HilProtocolParser-Sync.cpp
    ${CMAKE_CURRENT_SOURCE_DIR}/../../Src/Embedded/Transport/Parser/HilProtocolParser-Frame.cpp
    ${CMAKE_CURRENT_SOURCE_DIR}/../../Src/Embedded/Transport/Codec/HilProtocolCodec.cppm
    ${CMAKE_CURRENT_SOURCE_DIR}/../../Src/Embedded/Transport/Codec/HilProtocolCodec-Sensor.cpp
    ${CMAKE_CURRENT_SOURCE_DIR}/../../Src/Embedded/Transport/Codec/HilProtocolCodec-Actuator.cpp
)

include("${CMAKE_CURRENT_SOURCE_DIR}/../../cmake/ZephyrFirmware.cmake")
```

## prj.conf
```kconfig
CONFIG_CPP=y
CONFIG_GLIBCXX_LIBCPP=y
CONFIG_STD_CPP2B=y
CONFIG_NEWLIB_LIBC=y
CONFIG_SERIAL=y
CONFIG_UART_CONSOLE=y
CONFIG_UART_INTERRUPT_DRIVEN=y
CONFIG_RING_BUFFER=y
CONFIG_PRINTK=y
CONFIG_MAIN_STACK_SIZE=8192
CONFIG_HEAP_MEM_POOL_SIZE=0
CONFIG_GPIO=y
```

## boards/nucleo_l476rg.overlay
```dts
&usart2 {
    current-speed = <460800>;
};
```

## src/main.cpp
```c
/*
Filename: apps/fc1_stm32/src/main.cpp
Description: Minimal Zephyr entry point for the FC1 firmware runtime.

Copyright (c) 2026 Nicolas K.
All rights reserved.
*/

import Fc1Firmware;

/* Starts the FC1 firmware runtime. */
int main()
{
    return run_fc1_firmware();
}
```

## src/Fc1Firmware-Control.cpp
```c
/*
Filename: apps/fc1_stm32/src/Fc1Firmware-Control.cpp
Description: FC1 control cycle: sensor conversion, controller restart on a new run and
the control update executed for each validated HIL SensorPacket.

Copyright (c) 2026 Nicolas K.
All rights reserved.
*/

module;

#include <zephyr/device.h>
#include <zephyr/drivers/uart.h>
#include <zephyr/kernel.h>

module Fc1Firmware;

import std;

import Aircraft;
import FlightController;
import HalTypes;
import HilProtocol;
import InterFcLink;

namespace fc1 {

namespace {
    /* Converts the shared HIL sensor contract into the FC1 measurement type. */
    AircraftState to_aircraft_state(const FlightCore::HAL::SensorData& sensor) noexcept
    {
        return AircraftState{
            .x = sensor.position_x_m,
            .y = sensor.position_y_m,
            .z = sensor.altitude_baro_m,
            .vx = sensor.velocity_x_ms,
            .vy = sensor.velocity_y_ms,
            .vz = sensor.velocity_z_ms,
            .pitch = sensor.pitch_rad,
            .roll = sensor.roll_rad,
            .pitch_rate = sensor.gyro_pitch_rad_s,
            .roll_rate = sensor.gyro_roll_rad_s,
            .actual_rpm = sensor.wing_rpm_meas,
        };
    }
}

void send_frame(const device* uart, std::span<const std::uint8_t> frame) noexcept
{
    for (const std::uint8_t byte : frame) {
        uart_poll_out(uart, byte);
    }
}

void reset_controller(const Fc1Links& links,
                      Fc1Control&     control,
                      std::float32_t  station_hold_seconds) noexcept
{
    control.controller = sim::control::FlightController{
        sim::control::ControllerConfig{.hover_rpm = kNominalAircraftHoverRpm,
                                       .station_hold_seconds = station_hold_seconds}};
    inter_fc.remote_state = static_cast<std::uint8_t>(FlightCore::InterFc::NodeState::Unknown);
    inter_fc.remote_detection = static_cast<std::uint8_t>(FlightCore::InterFc::DetectionCode::None);
    const FlightCore::InterFc::Message reset_supervision{ .kind = FlightCore::InterFc::MessageKind::ResetSupervision, };
    static_cast<void>(links.inter_fc_transport->send(reset_supervision));
}

void process_sensor(const Fc1Links& links, Fc1Control& control) noexcept
{
    const FlightCore::Transport::HilHeader& header = control.header;

    if (header.msg_id != FlightCore::Transport::kMsgIdSensor
        || header.payload_len != FlightCore::Transport::kSensorPayloadSize) {
        return;
    }
    const std::span<const std::uint8_t> payload{control.payload.data(), header.payload_len};
    FlightCore::Transport::HilSensorPayload sensor_payload{};
    if (!FlightCore::Transport::decodeSensorPayload(payload, sensor_payload)) {
        return;
    }
    inter_fc.heartbeat_suppressed =
        (sensor_payload.sensor_valid_flags & FlightCore::Transport::kHilCommandSuppressInterFcHeartbeat) != 0
            ? 1u : 0u;
    if (header.sequence_num == 0 && sensor_payload.sim_timestamp_us == 0) {
        reset_controller(links, control, sensor_payload.setpoint.station_hold_seconds);
    }
    const FlightCore::HAL::SensorData sensor = FlightCore::Transport::toSensorData(sensor_payload);
    const AircraftState measured = to_aircraft_state(sensor);
    control.current_setpoint = sim::control::TargetState{
        .x = sensor_payload.setpoint.target_x_m,
        .y = sensor_payload.setpoint.target_y_m,
        .z = sensor_payload.setpoint.target_z_m,
    };
    const ControlCommand command = control.controller.update(control.current_setpoint, measured, kControlPeriodSeconds);
    publish_monitoring_sample(links, header, sensor, command);
    const std::uint8_t mode_flags = static_cast<std::uint8_t>(control.controller.state());
    const FlightCore::HAL::ActuatorCommands actuators = build_actuator_packet(command, mode_flags);
    send_actuator_response(links, header, actuators, sensor_payload.sim_timestamp_us);
}

}
```

## src/Fc1Firmware-InterFc.cpp
```c
/*
Filename: apps/fc1_stm32/src/Fc1Firmware-InterFc.cpp
Description: FC1 inter-FC link service: sends FC1 heartbeats, receives FC2
acknowledgements and statuses, and reports link progress periodically.

Copyright (c) 2026 Nicolas K.
All rights reserved.
*/

module;

#include <zephyr/kernel.h>
#include <zephyr/sys/printk.h>

module Fc1Firmware;

import std;

import InterFcLink;

namespace fc1 {

namespace {
    /* Consumes pending inter-FC messages and refreshes the remote supervision state. */
    void poll_inter_fc_messages(FlightCore::InterFc::IInterFcTransport& transport,
                                std::int64_t                            now_ms) noexcept
    {
        while (true) {
            const auto received = transport.poll();
            if (!received.has_value() || !received->has_value()) {
                break;
            }
            if ((*received)->kind == FlightCore::InterFc::MessageKind::Acknowledgement) {
                inter_fc.acknowledged_sequence = (*received)->sequence;
                inter_fc.acknowledgement_count = inter_fc.acknowledgement_count + 1;
            }
            if ((*received)->kind == FlightCore::InterFc::MessageKind::Acknowledgement
                || (*received)->kind == FlightCore::InterFc::MessageKind::Status) {
                inter_fc.last_remote_status_ms = now_ms;
                inter_fc.remote_state = static_cast<std::uint8_t>((*received)->state);
                inter_fc.remote_detection = static_cast<std::uint8_t>((*received)->detection);
            }
        }
    }
}

void service_inter_fc_link(const Fc1Links& links,
                           bool            heartbeat_suppressed,
                           std::int64_t&   last_heartbeat_ms,
                           std::int64_t&   last_report_ms) noexcept
{
    const std::int64_t now_ms = k_uptime_get();

    if (!heartbeat_suppressed && now_ms - last_heartbeat_ms >= kHeartbeatPeriodMs) {
        const FlightCore::InterFc::Message heartbeat{
            .kind = FlightCore::InterFc::MessageKind::Heartbeat,
            .sequence = inter_fc.next_sequence,
            .state = FlightCore::InterFc::NodeState::Healthy,
        };
        if (links.inter_fc_transport->send(heartbeat).has_value()) {
            inter_fc.heartbeat_count = inter_fc.heartbeat_count + 1;
            inter_fc.next_sequence = static_cast<std::uint16_t>(inter_fc.next_sequence + 1);
        }
        last_heartbeat_ms = now_ms;
    }
    poll_inter_fc_messages(*links.inter_fc_transport, now_ms);
    if (now_ms - last_report_ms >= kLinkReportPeriodMs) {
        printk("[INTERFC] role=FC1 heartbeats=%u acknowledgements=%u last_ack=%u "
               "remote_state=%u suppressed=%u\n",
               static_cast<unsigned int>(inter_fc.heartbeat_count),
               static_cast<unsigned int>(inter_fc.acknowledgement_count),
               static_cast<unsigned int>(inter_fc.acknowledged_sequence),
               static_cast<unsigned int>(inter_fc.remote_state),
               static_cast<unsigned int>(inter_fc.heartbeat_suppressed));
        last_report_ms = now_ms;
    }
}

}
```

## src/Fc1Firmware-Respond.cpp
```c
/*
Filename: apps/fc1_stm32/src/Fc1Firmware-Respond.cpp
Description: FC1 outgoing messages: monitoring sample publication to the FC2 supervisor
and the actuator response built and sent on the HIL console UART.

Copyright (c) 2026 Nicolas K.
All rights reserved.
*/

module;

#include <zephyr/kernel.h>

module Fc1Firmware;

import std;

import Aircraft;
import HalTypes;
import HilProtocol;
import HilProtocolCodec;
import InterFcLink;

namespace fc1 {

/* Publishes the monitoring sample of one control cycle to the FC2 supervisor. */
void publish_monitoring_sample(const Fc1Links&                         links,
                               const FlightCore::Transport::HilHeader& header,
                               const FlightCore::HAL::SensorData&      sensor,
                               const ControlCommand&                   command) noexcept
{
    const FlightCore::InterFc::Message monitoring_sample{
        .kind = FlightCore::InterFc::MessageKind::MonitoringSample,
        .sequence = header.sequence_num,
        .state = FlightCore::InterFc::NodeState::Healthy,
        .detection = FlightCore::InterFc::DetectionCode::None,
        .altitude_m = sensor.altitude_baro_m,
        .actual_rpm = sensor.wing_rpm_meas,
        .commanded_rpm = static_cast<std::float32_t>(command.wing_rpm),
    };

    static_cast<void>(links.inter_fc_transport->send(monitoring_sample));
}

/* Builds the actuator packet of one control cycle from the FC1 command. */
FlightCore::HAL::ActuatorCommands build_actuator_packet(const ControlCommand& command,
                                                        std::uint8_t          mode_flags) noexcept
{
    return FlightCore::HAL::ActuatorCommands{
        .timestamp_us = static_cast<std::uint64_t>(k_uptime_get()) * 1000u,
        .wing_rpm_cmd = static_cast<std::float32_t>(command.wing_rpm),
        .left_servo_rad = static_cast<std::float32_t>(command.left_servo_angle * kRadiansPerDegree),
        .right_servo_rad = static_cast<std::float32_t>(command.right_servo_angle * kRadiansPerDegree),
        .aux_actuator_cmd = 0.0f,
        .mode_flags = mode_flags,
    };
}

/* Sends the actuator answer of one control cycle on the HIL console UART. */
void send_actuator_response(const Fc1Links&                          links,
                            const FlightCore::Transport::HilHeader&  header,
                            const FlightCore::HAL::ActuatorCommands& actuators,
                            std::uint64_t                            sim_timestamp_us) noexcept
{
    const FlightCore::Transport::ActuatorDiagnostics diagnostics{
        .fc_health_status = inter_fc.remote_state,
        .fc_detection_code = inter_fc.remote_detection,
    };
    const FlightCore::Transport::HilActuatorPayload response_payload =
        FlightCore::Transport::makeActuatorPayload(actuators, sim_timestamp_us, diagnostics);
    const std::array<std::uint8_t, FlightCore::Transport::kActuatorFrameSize> response =
        FlightCore::Transport::encodeActuatorFrame(response_payload, header.sequence_num);

    send_frame(links.uart, response);
    status_led.mark_activity(k_uptime_get());
}

}
```

## src/Fc1Firmware-Run.cpp
```c
/*
Filename: apps/fc1_stm32/src/Fc1Firmware-Run.cpp
Description: FC1 Zephyr entry point and main dispatch loop over the HIL console UART.

Copyright (c) 2026 Nicolas K.
All rights reserved.
*/

module;

#include <zephyr/device.h>
#include <zephyr/devicetree.h>
#include <zephyr/drivers/uart.h>
#include <zephyr/kernel.h>
#include <zephyr/sys/printk.h>
#include <zephyr/sys/ring_buffer.h>

module Fc1Firmware;

import std;

import HilProtocol;
import HilProtocolParser;
import InterFcLink;
import StatusLed;

namespace fc1 {

namespace {
    RING_BUF_DECLARE(uart_receive_buffer, kUartReceiveCapacity);

    /* Collects the hardware handles of a booted FC1 unit. */
    struct Fc1Boot {
        FlightCore::InterFc::ZephyrUartInterFcTransport inter_fc_transport{nullptr};
        const device* uart = nullptr;
        bool ready = false;
    };

    /* Moves received UART bytes from the hardware FIFO into the static HIL ring buffer. */
    void receive_uart_bytes(const device* uart, void*) noexcept
    {
        std::array<std::uint8_t, 64> received_bytes{};

        while (uart_irq_update(uart) != 0 && uart_irq_is_pending(uart) != 0) {
            if (uart_irq_rx_ready(uart) == 0) {
                continue;
            }
            const std::int32_t received = uart_fifo_read(uart, received_bytes.data(), received_bytes.size());
            if (received > 0) {
                ring_buf_put(&uart_receive_buffer, received_bytes.data(), static_cast<std::uint32_t>(received));
            }
        }
    }

    /* Configures the HIL console UART (interrupt reception) and the inter-FC USART. */
    Fc1Boot boot_fc1_hardware()
    {
        Fc1Boot       boot{.uart = DEVICE_DT_GET(DT_CHOSEN(zephyr_console))};
        const device* inter_fc_uart = DEVICE_DT_GET(DT_NODELABEL(usart3));

        boot.inter_fc_transport = FlightCore::InterFc::ZephyrUartInterFcTransport{inter_fc_uart};
        inter_fc.startup_state = 1;
        if (!device_is_ready(boot.uart)) {
            return boot;
        }
        inter_fc.startup_state = 2;
        if (!boot.inter_fc_transport.ready()) {
            return boot;
        }
        inter_fc.startup_state = 3;
        if (uart_irq_callback_user_data_set(boot.uart, receive_uart_bytes, nullptr) != 0) {
            return boot;
        }
        uart_irq_rx_enable(boot.uart);
        inter_fc.startup_state = 4;
        boot.ready = true;
        return boot;
    }
}

/* Zephyr FC1 entry point. Incoming SensorPackets provide the 100 Hz release cadence. */
export int run_fc1_firmware()
{
    const auto led_initialized = status_led.initialize();

    if (!led_initialized.has_value()) {
        printk("[LED] initialization failed: %d\n", led_initialized.error());
    }
    const Fc1Boot boot = boot_fc1_hardware();
    if (!boot.ready) {
        return -1;
    }
    printk("[BOOT] firmware=fc1_stm32 role=FC1 board=nucleo_l476rg hil_baud=460800 "
           "inter_fc=USART3/PB10/PB11/115200\n");

    const Fc1Links links{.uart = boot.uart, .inter_fc_transport = &boot.inter_fc_transport};
    Fc1Control control{};
    std::int64_t last_heartbeat_ms = -kHeartbeatPeriodMs;
    std::int64_t last_report_ms = 0;

    while (true) {
        service_inter_fc_link(links, inter_fc.heartbeat_suppressed != 0, last_heartbeat_ms, last_report_ms);
        update_status_led();
        std::uint8_t byte = 0;
        if (ring_buf_get(&uart_receive_buffer, &byte, 1) == 1) {
            const bool complete = control.parser.processByte(byte, control.header, control.payload);
            if (complete) {
                process_sensor(links, control);
            }
        }
        else {
            k_sleep(K_MSEC(1));
        }
    }
}

}
```

## src/Fc1Firmware-State.cpp
```c
/*
Filename: apps/fc1_stm32/src/Fc1Firmware-State.cpp
Description: Shared mutable state of the FC1 firmware units: inter-FC link bookkeeping, the
status LED instance and its supervision-driven update.

Copyright (c) 2026 Nicolas K.
All rights reserved.
*/

module;

#include <zephyr/kernel.h>

module Fc1Firmware;

import std;

import InterFcLink;
import StatusLed;

namespace fc1 {

Fc1InterFc inter_fc{};
FlightCore::Status::StatusLed status_led{};

/* Advances the status LED from the current inter-FC supervision state. */
void update_status_led() noexcept
{
    const std::int64_t now_ms = k_uptime_get();
    const bool remote_missing = inter_fc.last_remote_status_ms < 0
        ? now_ms >= 2000 : now_ms - inter_fc.last_remote_status_ms >= 500;
    const bool led_fault = remote_missing || inter_fc.heartbeat_suppressed != 0
        || inter_fc.remote_state == static_cast<std::uint8_t>(FlightCore::InterFc::NodeState::Degraded)
        || inter_fc.remote_state == static_cast<std::uint8_t>(FlightCore::InterFc::NodeState::Safe)
        || inter_fc.remote_detection != static_cast<std::uint8_t>(FlightCore::InterFc::DetectionCode::None);

    static_cast<void>(status_led.update(now_ms, led_fault));
}

}
```
