## CMakeLists.txt
```
cmake_minimum_required(VERSION 4.4)

set(CMAKE_EXPERIMENTAL_CXX_IMPORT_STD
    "f35a9ac6-8463-4d38-8eec-5d6008153e7d"
    CACHE STRING "Enable experimental C++ import std support")
project(fc2_stm32_bootstrap LANGUAGES NONE)

set(FIRMWARE_NAME fc2_stm32)
set(FIRMWARE_MAIN "${CMAKE_CURRENT_SOURCE_DIR}/src/main.cpp")
set(FIRMWARE_CORE_FILES
    ${CMAKE_CURRENT_SOURCE_DIR}/src/Fc2Firmware.cppm
    ${CMAKE_CURRENT_SOURCE_DIR}/src/Fc2Firmware-Boot.cpp
    ${CMAKE_CURRENT_SOURCE_DIR}/src/Fc2Firmware-Convert.cpp
    ${CMAKE_CURRENT_SOURCE_DIR}/src/Fc2Firmware-InterFc.cpp
    ${CMAKE_CURRENT_SOURCE_DIR}/src/Fc2Firmware-Safety.cpp
    ${CMAKE_CURRENT_SOURCE_DIR}/src/Fc2Firmware-Process.cpp
    ${CMAKE_CURRENT_SOURCE_DIR}/src/Fc2Firmware-Run.cpp
    ${CMAKE_CURRENT_SOURCE_DIR}/../../Src/Embedded/Status/StatusLed.cppm
    ${CMAKE_CURRENT_SOURCE_DIR}/../../Src/Embedded/Status/StatusLed.cpp
    ${CMAKE_CURRENT_SOURCE_DIR}/../../Src/Simulation/Aircraft.cppm
    ${CMAKE_CURRENT_SOURCE_DIR}/../../Src/Simulation/PhysicsDispersion.cppm
    ${CMAKE_CURRENT_SOURCE_DIR}/../../Src/SIL/Core/Comms/CommsBus.cppm
    ${CMAKE_CURRENT_SOURCE_DIR}/../../Src/SIL/Core/Telemetry/Telemetry.cppm
    ${CMAKE_CURRENT_SOURCE_DIR}/../../Src/SIL/Core/Telemetry/Telemetry-Chain.cpp
    ${CMAKE_CURRENT_SOURCE_DIR}/../../Src/SIL/Core/Telemetry/Telemetry-Validation.cpp
    ${CMAKE_CURRENT_SOURCE_DIR}/../../Src/Safety/HealthMonitor.cppm
    ${CMAKE_CURRENT_SOURCE_DIR}/../../Src/Safety/HealthMonitor-Core.cpp
    ${CMAKE_CURRENT_SOURCE_DIR}/../../Src/Safety/HealthMonitor-Evaluate.cpp
    ${CMAKE_CURRENT_SOURCE_DIR}/../../Src/Safety/HealthMonitor-Report.cpp
    ${CMAKE_CURRENT_SOURCE_DIR}/../../Src/Safety/HealthMonitor-Names.cpp
    ${CMAKE_CURRENT_SOURCE_DIR}/../../Src/Safety/SafetyManager.cppm
    ${CMAKE_CURRENT_SOURCE_DIR}/../../Src/Safety/SafetyManager.cpp
    ${CMAKE_CURRENT_SOURCE_DIR}/../../Src/Embedded/Hal/HalTypes.cppm
    ${CMAKE_CURRENT_SOURCE_DIR}/../../Src/Embedded/InterFc/InterFcLink.cppm
    ${CMAKE_CURRENT_SOURCE_DIR}/../../Src/Embedded/InterFc/InterFcLink-Codec.cpp
    ${CMAKE_CURRENT_SOURCE_DIR}/../../Src/Embedded/InterFc/InterFcLink-Crc.cpp
    ${CMAKE_CURRENT_SOURCE_DIR}/../../Src/Embedded/InterFc/InterFcLink-Parser.cpp
    ${CMAKE_CURRENT_SOURCE_DIR}/../../Src/Embedded/InterFc/ZephyrUartInterFcTransport.cppm
    ${CMAKE_CURRENT_SOURCE_DIR}/../../Src/Embedded/InterFc/ZephyrUartInterFcTransport.cpp
    ${CMAKE_CURRENT_SOURCE_DIR}/../../Src/Embedded/Transport/HilProtocol.cppm
    ${CMAKE_CURRENT_SOURCE_DIR}/../../Src/Embedded/Transport/Parser/HilProtocolParser.cppm
    ${CMAKE_CURRENT_SOURCE_DIR}/../../Src/Embedded/Transport/Parser/HilProtocolParser-Crc.cpp
    ${CMAKE_CURRENT_SOURCE_DIR}/../../Src/Embedded/Transport/Parser/HilProtocolParser-Sync.cpp
    ${CMAKE_CURRENT_SOURCE_DIR}/../../Src/Embedded/Transport/Parser/HilProtocolParser-Frame.cpp
    ${CMAKE_CURRENT_SOURCE_DIR}/../../Src/Embedded/Transport/Codec/HilProtocolCodec.cppm
    ${CMAKE_CURRENT_SOURCE_DIR}/../../Src/Embedded/Transport/Codec/HilProtocolCodec-Sensor.cpp
    ${CMAKE_CURRENT_SOURCE_DIR}/../../Src/Embedded/Transport/Codec/HilProtocolCodec-Actuator.cpp
)

include("${CMAKE_CURRENT_SOURCE_DIR}/../../cmake/ZephyrFirmware.cmake")
```

## prj.conf
```kconfig
CONFIG_CPP=y
CONFIG_GLIBCXX_LIBCPP=y
CONFIG_STD_CPP2B=y
CONFIG_NEWLIB_LIBC=y
CONFIG_SERIAL=y
CONFIG_UART_CONSOLE=y
CONFIG_UART_INTERRUPT_DRIVEN=y
CONFIG_PRINTK=y
CONFIG_MAIN_STACK_SIZE=8192
CONFIG_HEAP_MEM_POOL_SIZE=0
CONFIG_GPIO=y
```

## boards/nucleo_l476rg.overlay
```dts
&usart3 {
    status = "okay";
    current-speed = <115200>;
};
```

## src/main.cpp
```c
/*
Filename: apps/fc2_stm32/src/main.cpp
Description: Minimal Zephyr entry point for the FC2 firmware runtime.

Copyright (c) 2026 Nicolas K.
All rights reserved.
*/

import Fc2Firmware;

/* Starts the FC2 firmware runtime. */
int main()
{
    return run_fc2_firmware();
}
```

## src/Fc2Firmware-Boot.cpp
```c
/*
Filename: apps/fc2_stm32/src/Fc2Firmware-Boot.cpp
Description: Shared mutable state of the FC2 firmware units (link bookkeeping, status LED)
and the boot sequence resolving the HIL console UART and the inter-FC USART.

Copyright (c) 2026 Nicolas K.
All rights reserved.
*/

module;

#include <zephyr/device.h>
#include <zephyr/devicetree.h>
#include <zephyr/kernel.h>

module Fc2Firmware;

import std;

import InterFcLink;
import StatusLed;

namespace fc2 {

Fc2Link inter_fc{};
FlightCore::Status::StatusLed status_led{};

/* Advances the status LED from the current supervision state. */
void update_status_led(FlightCore::InterFc::NodeState     node_state,
                       FlightCore::InterFc::DetectionCode detection) noexcept
{
    const bool led_fault = node_state != FlightCore::InterFc::NodeState::Healthy
        || detection != FlightCore::InterFc::DetectionCode::None;

    static_cast<void>(status_led.update(k_uptime_get(), led_fault));
}

Fc2Boot boot_fc2_hardware()
{
    Fc2Boot       boot{.uart = DEVICE_DT_GET(DT_CHOSEN(zephyr_console))};
    const device* inter_fc_uart = DEVICE_DT_GET(DT_NODELABEL(usart3));

    boot.inter_fc_transport = FlightCore::InterFc::ZephyrUartInterFcTransport{inter_fc_uart};
    inter_fc.startup_state = 1;
    if (!device_is_ready(boot.uart)) {
        return boot;
    }
    inter_fc.startup_state = 2;
    if (!boot.inter_fc_transport.ready()) {
        return boot;
    }
    inter_fc.startup_state = 3;
    boot.ready = true;
    return boot;
}

}
```

## src/Fc2Firmware-Convert.cpp
```c
/*
Filename: apps/fc2_stm32/src/Fc2Firmware-Convert.cpp
Description: FC2 type conversions between the inter-FC vocabulary and the shared health,
safety and telemetry cores.

Copyright (c) 2026 Nicolas K.
All rights reserved.
*/

module;

#include <zephyr/kernel.h>

module Fc2Firmware;

import std;

import HealthMonitor;
import InterFcLink;
import SafetyManager;
import Telemetry;

namespace fc2 {

namespace {
    /* Restarts the health and safety cores at their configured timeouts. */
    sim::safety::HealthMonitor make_monitor()
    {
        return sim::safety::HealthMonitor{sim::safety::HealthMonitorConfig{
            .heartbeat_timeout_s = kHeartbeatTimeoutSeconds,
            .initial_heartbeat_timeout_s = kInitialHeartbeatTimeoutSeconds,
        }};
    }
}

/* Maps the safety manager state to the transport-independent FC-to-FC status. */
FlightCore::InterFc::NodeState to_node_state(sim::safety::SafetyMode mode) noexcept
{
    switch (mode) {
    case sim::safety::SafetyMode::NORMAL:
        return FlightCore::InterFc::NodeState::Healthy;
    case sim::safety::SafetyMode::COMPENSATED:
        return FlightCore::InterFc::NodeState::Degraded;
    case sim::safety::SafetyMode::SAFE_MODE:
        return FlightCore::InterFc::NodeState::Safe;
    }
    return FlightCore::InterFc::NodeState::Unknown;
}

/* Maps the first active FC2 detection to the inter-FC diagnostic vocabulary. */
FlightCore::InterFc::DetectionCode to_detection_code(const sim::safety::HealthReport& report) noexcept
{
    for (std::size_t index = 0; index < report.flags.size(); ++index) {
        if (!report.flags[index].raised) {
            continue;
        }
        switch (static_cast<sim::safety::DetectionEvent>(index)) {
        case sim::safety::DetectionEvent::FC1_HEARTBEAT_TIMEOUT:
            return FlightCore::InterFc::DetectionCode::Fc1HeartbeatTimeout;
        case sim::safety::DetectionEvent::COMMUNICATION_TIMEOUT:
            return FlightCore::InterFc::DetectionCode::CommunicationTimeout;
        case sim::safety::DetectionEvent::SENSOR_VALIDATION_FAILED:
            return FlightCore::InterFc::DetectionCode::SensorValidationFailed;
        case sim::safety::DetectionEvent::ACTUATOR_MISMATCH:
            return FlightCore::InterFc::DetectionCode::ActuatorMismatch;
        }
    }
    return FlightCore::InterFc::DetectionCode::None;
}

/* Converts a HIL sensor packet into the telemetry consumed by the FC2 core. */
sim::sil::SensorTelemetry to_telemetry(const FlightCore::HAL::SensorData& sensor) noexcept
{
    return sim::sil::SensorTelemetry{
        .x = sensor.position_x_m,
        .y = sensor.position_y_m,
        .z = sensor.altitude_baro_m,
        .vx = sensor.velocity_x_ms,
        .vy = sensor.velocity_y_ms,
        .vz = sensor.velocity_z_ms,
        .pitch = sensor.pitch_rad,
        .roll = sensor.roll_rad,
        .actual_rpm = sensor.wing_rpm_meas,
    };
}

/* Restarts the health and safety supervision when a new run resets the session. */
void reset_supervision(Fc2Health& health) noexcept
{
    health.monitor = make_monitor();
    health.safety = sim::safety::SafetyManager{};
    health.reset_requested = false;
    health.telemetry = sim::sil::SensorTelemetry{};
    health.commanded_rpm = 0.0;
    sim::safety::rearm_link_supervision(
        health.supervision, static_cast<std::float64_t>(k_uptime_get()) / 1000.0);
}

}
```

## src/Fc2Firmware-InterFc.cpp
```c
/*
Filename: apps/fc2_stm32/src/Fc2Firmware-InterFc.cpp
Description: FC2 inter-FC link service: receives FC1 heartbeats, acknowledges them,
refreshes the FC2 link supervision and reports link progress periodically.

Copyright (c) 2026 Nicolas K.
All rights reserved.
*/

module;

#include <zephyr/kernel.h>
#include <zephyr/sys/printk.h>

module Fc2Firmware;

import std;

import InterFcLink;

namespace fc2 {

namespace {
    /* Consumes pending FC1 messages and refreshes the supervised link state. */
    void poll_inter_fc_messages(FlightCore::InterFc::IInterFcTransport& transport,
                                Fc2Health&                              health,
                                FlightCore::InterFc::NodeState          node_state,
                                FlightCore::InterFc::DetectionCode      detection) noexcept
    {
        while (true) {
            const auto received = transport.poll();
            if (!received.has_value() || !received->has_value()) {
                break;
            }
            if ((*received)->kind == FlightCore::InterFc::MessageKind::ResetSupervision) {
                health.reset_requested = true;
                continue;
            }
            if ((*received)->kind == FlightCore::InterFc::MessageKind::MonitoringSample) {
                health.telemetry.z = (*received)->altitude_m;
                health.telemetry.actual_rpm = (*received)->actual_rpm;
                health.commanded_rpm = (*received)->commanded_rpm;
                continue;
            }
            if ((*received)->kind != FlightCore::InterFc::MessageKind::Heartbeat) {
                continue;
            }
            status_led.mark_activity(k_uptime_get());
            inter_fc.last_sequence = (*received)->sequence;
            inter_fc.heartbeat_count = inter_fc.heartbeat_count + 1;
            health.supervision.last_heartbeat_time = static_cast<std::float64_t>(k_uptime_get()) / 1000.0;
            const FlightCore::InterFc::Message acknowledgement{
                .kind = FlightCore::InterFc::MessageKind::Acknowledgement,
                .sequence = inter_fc.last_sequence,
                .state = node_state,
                .detection = detection,
            };
            if (transport.send(acknowledgement).has_value()) {
                inter_fc.acknowledgement_count = inter_fc.acknowledgement_count + 1;
            }
        }
    }
}

void service_inter_fc_link(FlightCore::InterFc::IInterFcTransport& transport,
                           Fc2Health&                              health,
                           FlightCore::InterFc::NodeState          node_state,
                           FlightCore::InterFc::DetectionCode      detection,
                           std::int64_t&                           last_report_ms) noexcept
{
    poll_inter_fc_messages(transport, health, node_state, detection);
    const std::int64_t now_ms = k_uptime_get();
    if (now_ms - last_report_ms >= kLinkReportPeriodMs) {
        printk("[INTERFC] role=FC2 heartbeats=%u acknowledgements=%u last_heartbeat=%u\n",
               static_cast<unsigned int>(inter_fc.heartbeat_count),
               static_cast<unsigned int>(inter_fc.acknowledgement_count),
               static_cast<unsigned int>(inter_fc.last_sequence));
        last_report_ms = now_ms;
    }
}

/* Reports FC2 raw-byte and validated-frame diagnostics for the USART3 adapter. */
void report_inter_fc_transport(const FlightCore::InterFc::ZephyrUartInterFcTransport& transport,
                               std::int64_t&                                          last_transport_report_ms) noexcept
{
    const std::int64_t now_ms = k_uptime_get();

    if (now_ms - last_transport_report_ms >= kLinkReportPeriodMs) {
        printk("[INTERFC-RX] role=FC2 bytes=%u valid_frames=%u\n",
               static_cast<unsigned int>(transport.received_byte_count()),
               static_cast<unsigned int>(transport.valid_frame_count()));
        last_transport_report_ms = now_ms;
    }
}

}
```

## src/Fc2Firmware-Process.cpp
```c
/*
Filename: apps/fc2_stm32/src/Fc2Firmware-Process.cpp
Description: FC2 HIL sensor processing: runs the health evaluation and returns its safety
decision as a HIL actuator response on the console UART.

Copyright (c) 2026 Nicolas K.
All rights reserved.
*/

module;

#include <zephyr/device.h>
#include <zephyr/drivers/uart.h>
#include <zephyr/kernel.h>

module Fc2Firmware;

import std;

import HalTypes;
import HilProtocol;
import HilProtocolCodec;

namespace fc2 {

void send_frame(const device* uart, std::span<const std::uint8_t> frame) noexcept
{
    for (const std::uint8_t byte : frame) {
        uart_poll_out(uart, byte);
    }
}

void process_sensor(const device*                           uart,
                    Fc2Health&                              health,
                    const FlightCore::Transport::HilHeader& header,
                    std::span<const std::uint8_t>           payload) noexcept
{
    FlightCore::Transport::HilSensorPayload sensor_payload{};

    if (!FlightCore::Transport::decodeSensorPayload(payload, sensor_payload)) {
        return;
    }
    const std::float64_t now = static_cast<std::float64_t>(k_uptime_get()) / 1000.0;
    const auto sensor = FlightCore::Transport::toSensorData(sensor_payload);
    const auto telemetry = to_telemetry(sensor);
    const auto report = health.monitor.evaluate(now, health.supervision, telemetry, sensor.wing_rpm_meas);
    const auto command = health.safety.update(now, report);
    const FlightCore::HAL::ActuatorCommands response_command{
        .timestamp_us = static_cast<std::uint64_t>(k_uptime_get()) * 1000u,
        .wing_rpm_cmd = 0.0f,
        .left_servo_rad = 0.0f,
        .right_servo_rad = 0.0f,
        .aux_actuator_cmd = static_cast<std::float32_t>(command.thrust_margin),
        .mode_flags = static_cast<std::uint8_t>(health.safety.mode()),
    };
    const FlightCore::Transport::ActuatorDiagnostics diagnostics{
        .fc_health_status = static_cast<std::uint8_t>(report.state),
    };
    const auto response_payload = FlightCore::Transport::makeActuatorPayload(
        response_command, sensor_payload.sim_timestamp_us, diagnostics);
    const auto response = FlightCore::Transport::encodeActuatorFrame(response_payload, header.sequence_num);
    send_frame(uart, response);
}

}
```

## src/Fc2Firmware-Run.cpp
```c
/*
Filename: apps/fc2_stm32/src/Fc2Firmware-Run.cpp
Description: FC2 Zephyr entry point and main supervision loop over the HIL console UART.

Copyright (c) 2026 Nicolas K.
All rights reserved.
*/

module;

#include <zephyr/device.h>
#include <zephyr/devicetree.h>
#include <zephyr/drivers/uart.h>
#include <zephyr/kernel.h>
#include <zephyr/sys/printk.h>

module Fc2Firmware;

import std;

import HealthMonitor;
import HilProtocol;
import HilProtocolParser;
import InterFcLink;
import SafetyManager;
import Telemetry;

namespace fc2 {

namespace {
    /* Run-local health, safety and HIL parsing state of the supervision loop. */
    struct Fc2Session {
        sim::safety::LinkSupervision supervision{
            .link_up = true,
            .last_heartbeat_time = -1.0,
            .monitoring_started_time = static_cast<std::float64_t>(k_uptime_get()) / 1000.0,
        };
        sim::safety::HealthMonitor monitor{sim::safety::HealthMonitorConfig{
            .heartbeat_timeout_s = kHeartbeatTimeoutSeconds,
            .initial_heartbeat_timeout_s = kInitialHeartbeatTimeoutSeconds,
        }};
        sim::safety::SafetyManager safety{};
        sim::sil::SensorTelemetry telemetry{};
        std::float64_t commanded_rpm = 0.0;
        bool reset_requested = false;
        Fc2Health health{.supervision = supervision,
                         .monitor = monitor,
                         .safety = safety,
                         .telemetry = telemetry,
                         .commanded_rpm = commanded_rpm,
                         .reset_requested = reset_requested};
        FlightCore::Transport::HilFrameParser parser{};
        FlightCore::Transport::HilHeader header{};
        std::array<std::uint8_t, FlightCore::Transport::kMaxPayload> payload{};
        std::int64_t last_report_ms = 0;
        std::int64_t last_transport_report_ms = 0;
        std::int64_t last_status_ms = -kStatusPeriodMs;
        FlightCore::InterFc::NodeState node_state = FlightCore::InterFc::NodeState::Healthy;
        FlightCore::InterFc::DetectionCode detection = FlightCore::InterFc::DetectionCode::None;
    };

    /* Runs one iteration of the FC2 supervision loop. */
    void run_once(const Fc2Boot& boot, Fc2Session& session)
    {
        service_inter_fc_link(boot.inter_fc_transport, session.health, session.node_state,
                             session.detection, session.last_report_ms);
        if (session.reset_requested) {
            reset_supervision(session.health);
        }
        session.node_state = evaluate_fc1_health(session.health, session.detection);
        publish_fc2_status(boot.inter_fc_transport, session.node_state, session.detection, session.last_status_ms);
        report_inter_fc_transport(boot.inter_fc_transport, session.last_transport_report_ms);
        update_status_led(session.node_state, session.detection);
        std::uint8_t byte = 0;
        if (uart_poll_in(boot.uart, &byte) == 0) {
            const bool complete = session.parser.processByte(byte, session.header, session.payload);
            if (complete) {
                process_sensor(boot.uart, session.health, session.header,
                               std::span<const std::uint8_t>{session.payload.data(),
                                                             session.header.payload_len});
            }
        }
        else {
            k_sleep(K_MSEC(1));
        }
    }
}

/* Zephyr FC2 entry point. SensorPackets act as the initial supervision heartbeat. */
export int run_fc2_firmware()
{
    const auto led_initialized = status_led.initialize();

    if (!led_initialized.has_value()) {
        printk("[LED] initialization failed: %d\n", led_initialized.error());
    }
    const Fc2Boot boot = boot_fc2_hardware();
    if (!boot.ready) {
        return -1;
    }
    printk("[BOOT] firmware=fc2_stm32 role=FC2 board=nucleo_l476rg hil_baud=115200 "
           "inter_fc=USART3/PB10/PB11/115200\n");

    Fc2Session session{};
    inter_fc.startup_state = 4;

    while (true) {
        run_once(boot, session);
    }
}

}
```

## src/Fc2Firmware-Safety.cpp
```c
/*
Filename: apps/fc2_stm32/src/Fc2Firmware-Safety.cpp
Description: FC2 health evaluation and periodic status publication: applies the safety
decision to the monitored link and reports FC2 health on the inter-FC transport.

Copyright (c) 2026 Nicolas K.
All rights reserved.
*/

module;

#include <zephyr/kernel.h>
#include <zephyr/sys/printk.h>

module Fc2Firmware;

import std;

import HealthMonitor;
import InterFcLink;
import SafetyManager;

namespace fc2 {

FlightCore::InterFc::NodeState evaluate_fc1_health(Fc2Health&                          health,
                                                   FlightCore::InterFc::DetectionCode& detection) noexcept
{
    const std::float64_t          now = static_cast<std::float64_t>(k_uptime_get()) / 1000.0;
    const sim::safety::SafetyMode previous_mode = health.safety.mode();
    const sim::safety::HealthReport report =
        health.monitor.evaluate(now, health.supervision, health.telemetry, health.commanded_rpm);

    static_cast<void>(health.safety.update(now, report));
    const FlightCore::InterFc::NodeState node_state = to_node_state(health.safety.mode());
    inter_fc.node_state = static_cast<std::uint8_t>(node_state);
    detection = to_detection_code(report);
    if (health.safety.mode() != previous_mode) {
        printk("[HEALTH] role=FC2 health=%s safety=%s heartbeat_age_ms=%d\n",
               sim::safety::health_state_name(report.state).data(),
               sim::safety::safety_mode_name(health.safety.mode()).data(),
               health.supervision.last_heartbeat_time >= 0.0
                   ? static_cast<int>((now - health.supervision.last_heartbeat_time) * 1000.0)
                   : -1);
    }
    return node_state;
}

void publish_fc2_status(FlightCore::InterFc::IInterFcTransport& transport,
                        FlightCore::InterFc::NodeState          node_state,
                        FlightCore::InterFc::DetectionCode      detection,
                        std::int64_t&                           last_status_ms) noexcept
{
    const std::int64_t now_ms = k_uptime_get();

    if (now_ms - last_status_ms < kStatusPeriodMs) {
        return;
    }
    const FlightCore::InterFc::Message status{
        .kind = FlightCore::InterFc::MessageKind::Status,
        .sequence = inter_fc.last_sequence,
        .state = node_state,
        .detection = detection,
    };
    static_cast<void>(transport.send(status));
    last_status_ms = now_ms;
}

}
```
